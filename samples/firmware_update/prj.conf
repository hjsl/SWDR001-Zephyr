## prj.conf
```kconfig
# Enable logging (it need to be disabled for low power)
CONFIG_PRINTK=y
CONFIG_GPIO=y
CONFIG_SERIAL=y
CONFIG_CONSOLE=y
CONFIG_UART_CONSOLE=y
CONFIG_LOG=y
CONFIG_LOG_BACKEND_UART=y

CONFIG_SPI=y
CONFIG_LR11XX_LIB=y
CONFIG_LR11XX_EVENT_TRIGGER_OWN_THREAD=y

CONFIG_PINCTRL=y

CONFIG_ASSERT=y
CONFIG_DEBUG=y

CONFIG_MAIN_STACK_SIZE=4096

# Configure whether you are updating lr1110 or lr1120
# This will automatically include the latest transciever firmware for that chip
# in main.c
CONFIG_UPDATE_LR1120=y
```

## src/main.c
```c
#include <stdio.h>
#include <string.h>
#include <zephyr/device.h>
#include <zephyr/devicetree.h>
#include <zephyr/kernel.h>
#include <zephyr/logging/log.h>
#include <zephyr/types.h>

#include <lr11xx_firmware_update.h>

#include "apps_common.h"

LOG_MODULE_REGISTER(main);

#if CONFIG_UPDATE_LR1110
#include "lr1110_transceiver_0401.h"
#elif CONFIG_UPDATE_LR1120
#include "lr1120_transceiver_0201.h"
#else
#error "Unsupported update target. Select either CONFIG_UPDATE_LR1110 or CONFIG_UPDATE_LR1120."

/* Bellow line is here so that only the above error is printed */
#include "lr1110_transceiver_0303.h"
#endif

const struct device *dev = DEVICE_DT_GET(DT_NODELABEL(lr11xx));

int main(void)
{
	apps_common_lr11xx_system_init(dev);

	if (LR11XX_FIRMWARE_UPDATE_TO == LR1110_FIRMWARE_UPDATE_TO_TRX) {
		LOG_INF("Updating LR1110 to transceiver firmware 0x%04x ", LR11XX_FIRMWARE_VERSION);
	} else if (LR11XX_FIRMWARE_UPDATE_TO == LR1120_FIRMWARE_UPDATE_TO_TRX) {
		LOG_INF("Updating LR1120 to transceiver firmware 0x%04x ", LR11XX_FIRMWARE_VERSION);
	} else {
		LOG_ERR("Unsupported update type: 0x%04x ", LR11XX_FIRMWARE_VERSION);
		return 0;
	}

	const lr11xx_fw_update_status_t status =
		lr11xx_update_firmware(dev, LR11XX_FIRMWARE_UPDATE_TO, LR11XX_FIRMWARE_VERSION,
				       lr11xx_firmware_image, (uint32_t)LR11XX_FIRMWARE_IMAGE_SIZE);

	switch (status) {
	case LR11XX_FW_UPDATE_OK:
		LOG_INF("LR11XX firmware was updated successfully!");
		break;
	case LR11XX_FW_UPDATE_NOT_IN_PROD_MODE:
		LOG_ERR("LR11XX did not enter bootloader mode!");
		break;
	case LR11XX_FW_UPDATE_UNSUPPORTED:
		LOG_ERR("Selected firmware is not supported on this lr11xx chip! (You might have "
			"selected a lr1110 firmware but have a lr1120 chip, or vice versa)");
		break;
	case LR11XX_FW_UPDATE_ERROR:
		LOG_ERR("Firmware version after chip update does not match the selected firmware.");
		break;
	}

	return 0;
}
```
